#include <SPI.h>
#include <Wire.h>
#include <Adafruit_GFX.h>
#include <Adafruit_SSD1306.h>


#include <MIDI.h>

#define SCREEN_WIDTH 128 // OLED display width, in pixels
#define SCREEN_HEIGHT 64 // OLED display height, in pixels

// Declaration for an SSD1306 display connected to I2C (SDA, SCL pins)
// The pins for I2C are defined by the Wire-library. 
// On an arduino UNO:       A4(SDA), A5(SCL)
// On an arduino MEGA 2560: 20(SDA), 21(SCL)
// On an arduino LEONARDO:   2(SDA),  3(SCL), ...
#define OLED_RESET     -1 // Reset pin # (or -1 if sharing Arduino reset pin)
#define SCREEN_ADDRESS 0x3C ///< See datasheet for Address; 0x3D for 128x64, 0x3C for 128x32
Adafruit_SSD1306 display(SCREEN_WIDTH, SCREEN_HEIGHT, &Wire, OLED_RESET);


// 'smiley', 128x64px
const unsigned char smiley [] PROGMEM = {
  0x00, 0x00, 0x00, 0x00, 0x00, 0x00, 0x00, 0x00, 0x00, 0x00, 0x00, 0x00, 0x00, 0x00, 0x00, 0x00, 
  0x00, 0x00, 0x00, 0x00, 0x00, 0x00, 0x00, 0x00, 0x00, 0x00, 0x00, 0x00, 0x00, 0x00, 0x00, 0x00, 
  0x00, 0x00, 0x00, 0x00, 0x00, 0x00, 0x00, 0x00, 0x00, 0x00, 0x00, 0x00, 0x00, 0x00, 0x00, 0x00, 
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  0x00, 0x00, 0x00, 0x00, 0x00, 0x00, 0x00, 0x00, 0x00, 0x00, 0x00, 0x00, 0x00, 0x00, 0x00, 0x00
};




MIDI_CREATE_DEFAULT_INSTANCE();

int divisorStatus[4] = {1, 2, 4, 8}; 
String runStatus[2] = { "Stop ", "Start"};

volatile char divCounter = 0, runStat = 0, divStat = 0;

#define CLOCKS_PER_BEAT 24 // MIDI Clock Ticks
#define BUTTON_DIV 2

void dispRun(int runStat){
  
  display.setTextSize(3);
  display.setCursor(0,0);
  display.setTextColor(WHITE, BLACK);
  display.setCursor(0,32);
  display.print(runStatus[runStat]);
  display.display();
}

void dispDiv(int divIndex){
  display.setTextSize(3);
  display.setCursor(0,0);
  display.setTextColor(WHITE, BLACK); 
  display.print("1/" + String(divisorStatus[divIndex]));
  display.display();
}

void setup() {
  pinMode(6, OUTPUT);
  digitalWrite(6, LOW);

  pinMode(BUTTON_DIV,INPUT_PULLUP);


  display.begin(SSD1306_SWITCHCAPVCC, SCREEN_ADDRESS);

// Clear the buffer
  display.clearDisplay();

  display.drawBitmap(0, 0, smiley, 128, 64, WHITE);
  display.display();
  delay(2000); // Pause for 2 seconds

  // Clear the buffer
  display.clearDisplay();

  dispRun(runStat);
  dispDiv(divStat);

  MIDI.begin(4); // Launch MIDI and listen to channel 4
  MIDI.turnThruOff();
}

void loop() {

  if(!runStat)
    {
        if (digitalRead(BUTTON_DIV) == LOW) {
        divStat++;
        divStat = divStat % 4;
        dispDiv(divStat);
        delay(300); // ugly but just make life easier, no need to check debounce
        } 
    }

  
  if (MIDI.read())                // Is there a MIDI message incoming ?
    {
        switch(MIDI.getType())      // Get the type of the message we caught
        {
          
            case midi::Clock:
                if(!(divCounter&(divisorStatus[divStat]-1))){      
                  MIDI.sendClock();
                }
                divCounter++;
                break;
            case midi::Start:
                MIDI.sendStart();
                runStat = 1;
                dispRun(runStat);
                break;
            case midi::Stop:
                MIDI.sendStop();
                runStat = 0;
                dispRun(runStat);
                break;
            default:
                break;
          
        }
    }

}
